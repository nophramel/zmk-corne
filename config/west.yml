## config/west.yml
```yaml
manifest:
  remotes:
    - name: urob
      url-base: https://github.com/urob
    - name: nice-view-mod                         #new entry
      url-base: https://github.com/nophramel      #new entry
  projects:
    - name: zmk
      remote: urob
      revision: main
      import: app/west.yml
    - name: nice-view-mod                 #new entry
      remote: nophramel                   #new entry
      revision: main                      #new entry
  self:
    path: config
```
